## drivers/sensor/adi/ade7978/Kconfig
```kconfig
# Copyright (c) 2026 Filip Stojanovic <filipembedded@gmail.com>
# SPDX-License-Identifier: Apache-2.0

config ADE7978
	bool "ADE7978 Isolated energy metering chipset for poliphase shunt meters"
	default y
	depends on DT_HAS_ADI_ADE7978_ENABLED
	depends on SPI
	help
		Enable the driver for Analog Devices ADE7978 isolated energy chipset
		for poliphase shunt meters.
```
