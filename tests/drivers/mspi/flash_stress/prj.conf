## CMakeLists.txt
```
# Copyright (c) 2026 Filip Stojanovic <filipembedded@gmail.com>
# SPDX-License-Identifier: Apache-2.0

cmake_minimum_required(VERSION 3.28.0)
find_package(Zephyr REQUIRED HINTS $ENV{ZEPHYR_BASE})
project(mspi_stress)

FILE(GLOB app_sources src/*.c)
target_sources(app PRIVATE ${app_sources})
target_include_directories(app PRIVATE ${ZEPHYR_BASE}/drivers/flash)
```

## Kconfig
```
# Copyright (c) 2026 Filip Stojanovic <filipembedded@gmail.com>
# SPDX-License-Identifier: Apache-2.0

mainmenu "MSPI NOR stress test"

config MSPI_STRESS_REGION_MANUAL
	bool "Select the test region manually"
	help
	  By default the test uses the top 1 MiB of the partition labelled
	  "storage" on the device under test, or the top 1 MiB of the device
	  when it has no partitions. Enable this to give the offset yourself.
	  Data in the region is overwritten.

config MSPI_STRESS_REGION_OFFSET
	hex "Test region offset"
	depends on MSPI_STRESS_REGION_MANUAL
	default 0x0
	help
	  Absolute offset of the 1 MiB test region. Must be 64 KiB aligned.

config MSPI_STRESS_OUTSIDE_REGION
	bool "Allow writes outside the test region"
	help
	  Run the tests that erase the sectors around the 16 MiB boundary and
	  the last sector of the device. Data there is lost.

config MSPI_STRESS_PRBS_SEED
	hex "Seed of the pseudo random data"
	default 0x1d872b41
	help
	  Change it to get different data; the value is printed at start so a
	  failing run can be repeated with the same data.

config MSPI_STRESS_BIG_READ_SIZE
	int "Size of the single large read, in bytes"
	default 32768
	range 8192 65536

config MSPI_STRESS_CONCURRENCY_SECONDS
	int "Duration of the concurrency test, in seconds"
	default 5

config MSPI_STRESS_ERASE_BUDGET
	int "Maximum erases of one sector in a single run"
	default 50
	help
	  The run fails if any sector of the region was erased more often,
	  which would point to a runaway loop. A full run erases each sector
	  only a few times.

config MSPI_STRESS_REBOOT_LOOP
	bool "Warm reboot loop test"
	select REBOOT
	help
	  Each reboot only resets the MCU, so the flash stays in the mode the
	  driver left it in and the next init must cope. Every boot re-runs
	  only the S7 suite.

config MSPI_STRESS_REBOOT_CYCLES
	int "Number of warm reboots"
	default 5 if MSPI_STRESS_REBOOT_LOOP
	default 0

# Boots inside the reboot loop skip every suite except S7 on purpose.
config ZTEST_VERIFY_RUN_ALL
	default n if MSPI_STRESS_REBOOT_LOOP

source "Kconfig.zephyr"
```

## prj.conf
```kconfig
CONFIG_ZTEST=y
CONFIG_FLASH=y
CONFIG_FLASH_PAGE_LAYOUT=y
CONFIG_FLASH_JESD216_API=y
CONFIG_CRC=y
CONFIG_MAIN_STACK_SIZE=2048
CONFIG_ZTEST_STACK_SIZE=8192
CONFIG_TIMESLICING=y
CONFIG_TIMESLICE_SIZE=2
```

## src/common.c
```c
/*
 * Copyright (c) 2026 Filip Stojanovic <filipembedded@gmail.com>
 *
 * SPDX-License-Identifier: Apache-2.0
 */

#include <string.h>
#include <zephyr/sys/printk.h>
#include <zephyr/sys/util.h>

#include "stress.h"

struct stress_ctx stress;
struct stress_wear stress_wear;

uint8_t stress_exp[STRESS_SECTOR] __aligned(STRESS_ALIGN);
uint8_t stress_got[STRESS_SECTOR] __aligned(STRESS_ALIGN);
uint8_t stress_big[CONFIG_MSPI_STRESS_BIG_READ_SIZE + 2 * STRESS_ALIGN] __aligned(STRESS_ALIGN);

static uint8_t reread_a[STRESS_SECTOR] __aligned(STRESS_ALIGN);
static uint8_t reread_b[STRESS_SECTOR] __aligned(STRESS_ALIGN);

/* Partitions of the device under test, used to pick and protect the region. */
struct stress_part {
	const char *label;
	uint32_t off;
	uint32_t size;
	bool code;
};

#define STRESS_PART_NODE DT_CHILD(STRESS_NODE, partitions)

#define STRESS_IS_CODE(n)                                                                    \
	COND_CODE_1(DT_HAS_CHOSEN(zephyr_code_partition),                                   \
		    (DT_SAME_NODE(n, DT_CHOSEN(zephyr_code_partition))), (0))

#define STRESS_PART_ENTRY(n)                                                                 \
	{                                                                                    \
		.label = DT_PROP_OR(n, label, DT_NODE_FULL_NAME(n)),                         \
		.off = DT_REG_ADDR(n),                                                       \
		.size = DT_REG_SIZE(n),                                                      \
		.code = STRESS_IS_CODE(n),                                                   \
	},

static const struct stress_part parts[] = {
	COND_CODE_1(DT_NODE_EXISTS(STRESS_PART_NODE),
		    (DT_FOREACH_CHILD_STATUS_OKAY(STRESS_PART_NODE, STRESS_PART_ENTRY)), ())
	{ .label = NULL },
};

/* Code runs from this flash when it is the chosen zephyr,flash node. */
#define STRESS_DUT_IS_ZEPHYR_FLASH                                                           \
	COND_CODE_1(DT_HAS_CHOSEN(zephyr_flash),                                            \
		    (DT_SAME_NODE(DT_CHOSEN(zephyr_flash), STRESS_NODE)), (0))

static bool label_is_protected(const char *label)
{
	static const char *const prefixes[] = {
		"image", "slot", "mcuboot", "boot", "app", "code", "firmware",
	};

	for (size_t i = 0; i < ARRAY_SIZE(prefixes); i++) {
		if (strncmp(label, prefixes[i], strlen(prefixes[i])) == 0) {
			return true;
		}
	}

	return false;
}

static bool overlaps(uint32_t a, uint32_t alen, uint32_t b, uint32_t blen)
{
	return (a < b + blen) && (b < a + alen);
}

static uint8_t lanes_of(enum mspi_io_mode mode)
{
	switch (mode) {
	case MSPI_IO_MODE_SINGLE:
		return 1;
	case MSPI_IO_MODE_DUAL:
	case MSPI_IO_MODE_DUAL_1_1_2:
	case MSPI_IO_MODE_DUAL_1_2_2:
		return 2;
	case MSPI_IO_MODE_QUAD:
	case MSPI_IO_MODE_QUAD_1_1_4:
	case MSPI_IO_MODE_QUAD_1_4_4:
		return 4;
	default:
		return 8;
	}
}

#define STRESS_IO_MODE DT_STRING_TOKEN(STRESS_NODE, mspi_io_mode)

static int pick_region(void)
{
	const uint32_t need = STRESS_REGION_SIZE;

#if defined(CONFIG_MSPI_STRESS_REGION_MANUAL)
	stress.region = CONFIG_MSPI_STRESS_REGION_OFFSET;
	stress.region_src = "Kconfig MSPI_STRESS_REGION_OFFSET";
#else
	const struct stress_part *storage = NULL;
	bool any_part = false;

	for (const struct stress_part *p = parts; p->label != NULL; p++) {
		any_part = true;
		if ((strcmp(p->label, "storage") == 0) && (p->size >= need)) {
			storage = p;
			break;
		}
	}

	if (storage != NULL) {
		/* Top of the storage partition, aligned to a 64 KiB block. */
		stress.region = ROUND_DOWN(storage->off + storage->size - need, STRESS_BLOCK);
		stress.region_src = "top of the \"storage\" partition";
	} else if (!any_part && !STRESS_DUT_IS_ZEPHYR_FLASH) {
		stress.region = ROUND_DOWN(stress.dev_size - need, STRESS_BLOCK);
		stress.region_src = "top of the device (no partitions defined)";
	} else {
		printk("mspi_stress: no usable test region. Add a \"storage\" partition of at\n"
		       "least %u KiB on the device, or set CONFIG_MSPI_STRESS_REGION_MANUAL.\n",
		       need / 1024U);
		return -ENOSPC;
	}
#endif

	if ((stress.region % STRESS_BLOCK) != 0U ||
	    (stress.region + need) > stress.dev_size) {
		printk("mspi_stress: region 0x%08x + %u KiB does not fit a %u KiB device or is\n"
		       "not 64 KiB aligned\n", stress.region, need / 1024U,
		       stress.dev_size / 1024U);
		return -EINVAL;
	}

	for (const struct stress_part *p = parts; p->label != NULL; p++) {
		if (overlaps(stress.region, need, p->off, p->size) &&
		    (p->code || label_is_protected(p->label))) {
			printk("mspi_stress: region overlaps protected partition \"%s\"\n",
			       p->label);
			return -EPERM;
		}
	}

	return 0;
}

static int stress_init(void)
{
	const struct flash_parameters *fp;
	uint64_t size = 0;
	int rc;

	stress.dev = DEVICE_DT_GET(STRESS_NODE);
	if (!device_is_ready(stress.dev)) {
		printk("mspi_stress: %s is not ready (check the jedec-id and the bus setup)\n",
		       stress.dev->name);
		return -ENODEV;
	}

	rc = flash_get_size(stress.dev, &size);
	stress.dev_size = (rc == 0) ? (uint32_t)size : DT_PROP(STRESS_NODE, size) / 8U;

	fp = flash_get_parameters(stress.dev);
	stress.erase_value = fp->erase_value;
	stress.page_size = 256U;
	stress.read_lanes = lanes_of(DT_STRING_TOKEN_OR(STRESS_NODE, read_io_mode,
							 STRESS_IO_MODE));
	stress.write_lanes = lanes_of(DT_STRING_TOKEN_OR(STRESS_NODE, write_io_mode,
							  STRESS_IO_MODE));

	rc = pick_region();
	if (rc != 0) {
		return rc;
	}

	printk("\n=== mspi_stress ===\n");
	printk("device   : %s (%s), %u KiB\n", stress.dev->name,
	       DT_NODE_FULL_NAME(STRESS_NODE), stress.dev_size / 1024U);
	printk("io mode  : %s, data rate %s, %u MHz max\n",
	       DT_PROP(STRESS_NODE, mspi_io_mode),
	       DT_PROP_OR(STRESS_NODE, mspi_data_rate, "MSPI_DATA_RATE_SINGLE"),
	       DT_PROP_OR(STRESS_NODE, mspi_max_frequency, 0) / 1000000U);
	printk("lanes    : read %u, write %u\n", stress.read_lanes, stress.write_lanes);
	printk("region   : 0x%08x..0x%08x (%s)\n", stress.region,
	       stress.region + STRESS_REGION_SIZE - 1U, stress.region_src);
	printk("prbs seed: 0x%08x\n", (uint32_t)CONFIG_MSPI_STRESS_PRBS_SEED);
	printk("NOTE: data in the region is overwritten\n\n");

	return 0;
}

int stress_ensure_init(void)
{
	static int init_rc = 1;

	if (init_rc == 1) {
		init_rc = stress_init();
		stress.ready = (init_rc == 0);
	}

	return init_rc;
}

void stress_before(void *fixture)
{
	int rc = stress_ensure_init();

	ARG_UNUSED(fixture);

	zassert_ok(rc, "mspi_stress setup failed (%d), see the message above", rc);
}

int stress_erase(uint32_t off, uint32_t len)
{
	int rc = flash_erase(stress.dev, off, len);

	if (rc == 0) {
		stress_wear.erase_ops++;
		for (uint32_t s = off; s < off + len; s += STRESS_SECTOR) {
			if (s >= stress.region && s < stress.region + STRESS_REGION_SIZE) {
				stress_wear.erases[(s - stress.region) / STRESS_SECTOR]++;
			} else {
				stress_wear.erase_outside++;
			}
		}
	}

	return rc;
}

int stress_write(uint32_t off, const void *buf, size_t len)
{
	int rc = flash_write(stress.dev, off, buf, len);

	if (rc == 0) {
		stress_wear.bytes_written += len;
	}

	return rc;
}

int stress_read(uint32_t off, void *buf, size_t len)
{
	int rc = flash_read(stress.dev, off, buf, len);

	if (rc == 0) {
		stress_wear.bytes_read += len;
	}

	return rc;
}

uint32_t stress_seed(uint32_t tag)
{
	uint32_t s = (uint32_t)CONFIG_MSPI_STRESS_PRBS_SEED ^ (tag * 0x9e3779b9U);

	return (s == 0U) ? 0x1U : s;
}

void stress_fill_prbs(uint8_t *buf, size_t len, uint32_t seed)
{
	uint32_t x = (seed == 0U) ? 1U : seed;

	for (size_t i = 0; i < len; i++) {
		x ^= x << 13;
		x ^= x >> 17;
		x ^= x << 5;
		buf[i] = (uint8_t)(x >> 24);
	}
}

static uint32_t pos_in_cmd(uint32_t off, uint32_t ws)
{
	const uint32_t page = stress.page_size;

	/* The first program command starts at ws, the next ones at page boundaries. */
	if ((off / page) == (ws / page)) {
		return off - ws;
	}

	return off % page;
}

void stress_compare(const uint8_t *exp, const uint8_t *got, size_t len, uint32_t off,
		    uint32_t ws, struct stress_err *e)
{
	e->checked += len;

	for (size_t i = 0; i < len; i++) {
		uint8_t diff = exp[i] ^ got[i];

		if (diff == 0U) {
			continue;
		}

		e->bad_bytes++;
		if (!e->have_first) {
			e->have_first = true;
			e->first_off = off + i;
			e->first_exp = exp[i];
			e->first_got = got[i];
		}

		for (int b = 0; b < 8; b++) {
			if ((diff & BIT(b)) == 0U) {
				continue;
			}
			if ((got[i] & BIT(b)) != 0U) {
				e->bit01[b]++;
			} else {
				e->bit10[b]++;
			}
		}

		e->pos_cmd[MIN(pos_in_cmd(off + i, ws), STRESS_POS_BUCKETS)]++;
	}
}

bool stress_verify(uint32_t off, const uint8_t *exp, size_t len, uint32_t ws,
		   struct stress_err *e)
{
	uint32_t before = e->bad_bytes;
	size_t done = 0;

	while (done < len) {
		size_t n = MIN(len - done, sizeof(reread_a));
		int rc = stress_read(off + done, reread_a, n);

		if (rc != 0) {
			e->ops_failed++;
			printk("  read 0x%08x+%u failed: %d\n", off + (uint32_t)done,
			       (uint32_t)n, rc);
			return false;
		}

		uint32_t chunk_before = e->bad_bytes;

		stress_compare(exp + done, reread_a, n, off + done, ws, e);

		if (e->bad_bytes != chunk_before) {
			/* Re-read twice: same wrong data means it is stored wrong. */
			for (int r = 0; r < 2; r++) {
				if (stress_read(off + done, reread_b, n) != 0) {
					e->ops_failed++;
					break;
				}
				e->rereads++;
				for (size_t i = 0; i < n; i++) {
					if (reread_a[i] != reread_b[i]) {
						e->unstable++;
					}
				}
			}
		}

		done += n;
	}

	return e->bad_bytes == before;
}

bool stress_verify_erased(uint32_t off, size_t len, struct stress_err *e)
{
	static uint8_t erased_ref[STRESS_SECTOR];
	bool ok = true;

	memset(erased_ref, stress.erase_value, sizeof(erased_ref));
	for (size_t done = 0; done < len; done += sizeof(erased_ref)) {
		size_t n = MIN(len - done, sizeof(erased_ref));

		/* ws = off: an erase has no program command, positions stay relative. */
		ok &= stress_verify(off + done, erased_ref, n, off + done, e);
	}

	return ok;
}

void stress_err_merge(struct stress_err *dst, const struct stress_err *src)
{
	dst->checked += src->checked;
	dst->bad_bytes += src->bad_bytes;
	dst->rereads += src->rereads;
	dst->unstable += src->unstable;
	dst->ops_failed += src->ops_failed;
	for (int b = 0; b < 8; b++) {
		dst->bit01[b] += src->bit01[b];
		dst->bit10[b] += src->bit10[b];
	}
	for (int p = 0; p <= STRESS_POS_BUCKETS; p++) {
		dst->pos_cmd[p] += src->pos_cmd[p];
	}
	if (!dst->have_first && src->have_first) {
		dst->have_first = true;
		dst->first_off = src->first_off;
		dst->first_exp = src->first_exp;
		dst->first_got = src->first_got;
	}
}

void stress_report(const char *title, const struct stress_err *e)
{
	const uint8_t lanes = stress.read_lanes;

	if (e->bad_bytes == 0U && e->ops_failed == 0U) {
		printk("  [%s] OK, %u bytes checked\n", title, e->checked);
		return;
	}

	printk("\n  [%s] %u bad bytes of %u checked, %u failed operations\n", title,
	       e->bad_bytes, e->checked, e->ops_failed);

	if (e->bad_bytes == 0U) {
		return;
	}

	printk("  first: 0x%08x expected 0x%02x read 0x%02x\n", e->first_off, e->first_exp,
	       e->first_got);

	printk("  bit     0->1   1->0\n");
	for (int b = 7; b >= 0; b--) {
		printk("  bit%d %7u %6u\n", b, e->bit01[b], e->bit10[b]);
	}

	if (lanes > 1U) {
		printk("  lane    0->1   1->0   (%u data lanes, bit b on IO(b %% %u))\n", lanes,
		       lanes);
		for (uint8_t l = 0; l < lanes; l++) {
			uint32_t up = 0;
			uint32_t down = 0;

			for (int b = l; b < 8; b += lanes) {
				up += e->bit01[b];
				down += e->bit10[b];
			}
			printk("  IO%u  %7u %6u\n", l, up, down);
		}
	} else {
		printk("  single line mode: writes use IO0, reads use IO1\n");
	}

	printk("  position in page program command:");
	for (int p = 0; p < STRESS_POS_BUCKETS; p++) {
		if ((p % 16) == 0) {
			printk("\n   %3d:", p);
		}
		printk(" %u", e->pos_cmd[p]);
	}
	printk("\n   >=%d: %u\n", STRESS_POS_BUCKETS, e->pos_cmd[STRESS_POS_BUCKETS]);

	if (e->rereads == 0U) {
		printk("  re-read: not done\n");
	} else if (e->unstable == 0U) {
		printk("  re-read x%u: stable -> data is stored wrong (write/program/erase path)\n",
		       e->rereads);
	} else {
		printk("  re-read x%u: %u bytes changed between reads -> unstable read path\n",
		       e->rereads, e->unstable);
	}
	printk("\n");
}
```

## src/s1_identity.c
```c
/*
 * Copyright (c) 2026 Filip Stojanovic <filipembedded@gmail.com>
 *
 * SPDX-License-Identifier: Apache-2.0
 *
 * S1: identity. JEDEC ID and SFDP read from the chip after init, compared with
 * the devicetree, plus a sanity check of the decoded parameters.
 */

#include <string.h>
#include <zephyr/sys/byteorder.h>
#include <zephyr/sys/printk.h>

#include <jesd216.h>

#include "stress.h"

#define SFDP_MAX_PH 8

static uint8_t sfdp_hdr_buf[sizeof(struct jesd216_sfdp_header) +
			    SFDP_MAX_PH * sizeof(struct jesd216_param_header)] __aligned(4);
static uint32_t chip_bfp[64] __aligned(4);
static struct jesd216_param_header chip_bfp_ph;
static bool chip_bfp_valid;

#if DT_NODE_HAS_PROP(STRESS_NODE, sfdp_bfp)
static const uint8_t dt_bfp[] = DT_PROP(STRESS_NODE, sfdp_bfp);
#endif
#if DT_NODE_HAS_PROP(STRESS_NODE, sfdp_ff84)
static const uint8_t dt_ff84[] = DT_PROP(STRESS_NODE, sfdp_ff84);
#endif
#if DT_NODE_HAS_PROP(STRESS_NODE, sfdp_ff05)
static const uint8_t dt_ff05[] = DT_PROP(STRESS_NODE, sfdp_ff05);
#endif

static bool id_is_garbage(const uint8_t *id)
{
	/* All three bytes equal is what a floating or unanswered bus reads. */
	return (id[0] == id[1]) && (id[1] == id[2]);
}

ZTEST(s1_identity, test_1_1_jedec_id)
{
#if defined(CONFIG_FLASH_JESD216_API)
	/* Drivers write up to SPI_NOR_MAX_ID_LEN (3) bytes; keep some margin. */
	uint8_t id[3][8];
	int rc;

	/*
	 * Read after init, so the chip is already in its target io mode. This is
	 * the case that broke on octal parts (RDID without address and dummy).
	 */
	for (int i = 0; i < 3; i++) {
		rc = flash_read_jedec_id(stress.dev, id[i]);
		if (rc == -ENOTSUP || rc == -ENOSYS) {
			ztest_test_skip();
		}
		zassert_ok(rc, "flash_read_jedec_id() failed: %d", rc);
	}

	printk("  JEDEC ID read from chip: %02x %02x %02x\n", id[0][0], id[0][1], id[0][2]);

	zassert_mem_equal(id[0], id[1], 3, "JEDEC ID differs between reads (unstable bus)");
	zassert_mem_equal(id[0], id[2], 3, "JEDEC ID differs between reads (unstable bus)");
	zassert_false(id_is_garbage(id[0]),
		      "JEDEC ID %02x %02x %02x looks like an unanswered bus: check the RDID "
		      "address phase and dummy cycles in the current io mode",
		      id[0][0], id[0][1], id[0][2]);

#if DT_NODE_HAS_PROP(STRESS_NODE, jedec_id)
	static const uint8_t dt_id[] = DT_PROP(STRESS_NODE, jedec_id);

	printk("  JEDEC ID in devicetree : %02x %02x %02x\n", dt_id[0], dt_id[1], dt_id[2]);
	zassert_mem_equal(id[0], dt_id, 3,
			  "JEDEC ID mismatch: the chip may be another ordering variant "
			  "(e.g. Winbond -IQ 0x40 vs -IM 0x70)");
#else
	printk("  no jedec-id in devicetree, ID not verified\n");
#endif
#else
	ztest_test_skip();
#endif
}

#if defined(CONFIG_FLASH_JESD216_API) &&                                                    \
	(DT_NODE_HAS_PROP(STRESS_NODE, sfdp_bfp) || DT_NODE_HAS_PROP(STRESS_NODE, sfdp_ff84) ||  \
	 DT_NODE_HAS_PROP(STRESS_NODE, sfdp_ff05))
static int compare_table(const char *name, uint32_t addr, uint32_t chip_len,
			 const uint8_t *dt, size_t dt_len)
{
	static uint8_t chip[256] __aligned(4);
	uint32_t n = MIN(chip_len, sizeof(chip));
	int diffs = 0;
	int rc;

	rc = flash_sfdp_read(stress.dev, addr, chip, n);
	if (rc != 0) {
		printk("  %s: SFDP read failed: %d\n", name, rc);
		return -EIO;
	}

	if (dt_len == 0U) {
		printk("  %s: empty array in devicetree (table not used)\n", name);
		return 0;
	}

	if (dt_len != n) {
		printk("  %s: length differs, chip %u bytes, devicetree %u bytes\n", name, n,
		       (uint32_t)dt_len);
	}

	for (uint32_t i = 0; i < MIN(n, dt_len); i++) {
		if (chip[i] != dt[i]) {
			if (diffs < 16) {
				printk("  %s: DW%u byte %u: chip 0x%02x, devicetree 0x%02x\n",
				       name, i / 4U + 1U, i % 4U, chip[i], dt[i]);
			}
			diffs++;
		}
	}

	if (diffs == 0 && dt_len == n) {
		printk("  %s: devicetree matches the chip (%u bytes)\n", name, n);
	}

	return diffs + ((dt_len != n) ? 1 : 0);
}
#endif

ZTEST(s1_identity, test_1_2_sfdp_vs_devicetree)
{
#if defined(CONFIG_FLASH_JESD216_API)
	const struct jesd216_sfdp_header *hp = (const void *)sfdp_hdr_buf;
	int mismatches = 0;
	int rc;

	rc = flash_sfdp_read(stress.dev, 0, sfdp_hdr_buf, sizeof(sfdp_hdr_buf));
	if (rc == -ENOTSUP || rc == -ENOSYS) {
		ztest_test_skip();
	}
	zassert_ok(rc, "flash_sfdp_read() failed: %d", rc);

	zassert_equal(jesd216_sfdp_magic(hp), JESD216_SFDP_MAGIC,
		      "SFDP signature 0x%08x is wrong: the chip did not answer 5Ah correctly "
		      "in the current io mode", jesd216_sfdp_magic(hp));

	printk("  SFDP rev %u.%u, %u parameter headers\n", hp->rev_major, hp->rev_minor,
	       hp->nph + 1U);

	for (int i = 0; i <= MIN(hp->nph, SFDP_MAX_PH - 1); i++) {
		const struct jesd216_param_header *php = &hp->phdr[i];
		uint16_t id = jesd216_param_id(php);
		uint32_t addr = jesd216_param_addr(php);
		uint32_t len = jesd216_param_len(php);

		printk("  PH%d: id %04x rev %u.%u, %u DW at 0x%06x\n", i, id, php->rev_major,
		       php->rev_minor, php->len_dw, addr);

		if (id == JESD216_SFDP_PARAM_ID_BFP && !chip_bfp_valid) {
			uint32_t n = MIN(len, sizeof(chip_bfp));

			if (flash_sfdp_read(stress.dev, addr, chip_bfp, n) == 0) {
				chip_bfp_ph = *php;
				chip_bfp_ph.len_dw = n / 4U;
				chip_bfp_valid = true;
			}
#if DT_NODE_HAS_PROP(STRESS_NODE, sfdp_bfp)
			rc = compare_table("sfdp-bfp", addr, len, dt_bfp, sizeof(dt_bfp));
			mismatches += (rc < 0) ? 1 : rc;
#endif
		}
#if DT_NODE_HAS_PROP(STRESS_NODE, sfdp_ff84)
		if (id == JESD216_SFDP_PARAM_ID_4B_ADDR_INSTR) {
			rc = compare_table("sfdp-ff84", addr, len, dt_ff84, sizeof(dt_ff84));
			mismatches += (rc < 0) ? 1 : rc;
		}
#endif
#if DT_NODE_HAS_PROP(STRESS_NODE, sfdp_ff05)
		if (id == JESD216_SFDP_PARAM_ID_XSPI_PROFILE_1V0) {
			rc = compare_table("sfdp-ff05", addr, len, dt_ff05, sizeof(dt_ff05));
			mismatches += (rc < 0) ? 1 : rc;
		}
#endif
	}

#if !DT_NODE_HAS_PROP(STRESS_NODE, sfdp_bfp)
	printk("  no sfdp-bfp in devicetree, commands come from DT properties\n");
#endif

	zassert_equal(mismatches, 0,
		      "SFDP tables in devicetree differ from the chip (%d differences): the "
		      "driver is configured with parameters of another part", mismatches);
#else
	ztest_test_skip();
#endif
}

static const char *const qer_names[] = {
	"none", "S2B1v1", "S1B6", "S2B7", "S2B1v4", "S2B1v5", "S2B1v6", "reserved",
};

ZTEST(s1_identity, test_1_3_decoded_parameters)
{
	const struct jesd216_bfp *bfp = (const void *)chip_bfp;
	const struct jesd216_param_header *php = &chip_bfp_ph;
	struct jesd216_bfp_dw15 dw15;
	struct jesd216_bfp_dw16 dw16;
	struct jesd216_erase_type et;
	uint64_t density;
	int warnings = 0;

	if (!chip_bfp_valid) {
		printk("  BFP not read from the chip, nothing to decode\n");
		ztest_test_skip();
	}

	density = jesd216_bfp_density(bfp) / 8U;
	stress.page_size = jesd216_bfp_page_size(php, bfp);

	printk("  density %u KiB, page %u bytes, address bytes code %u\n",
	       (uint32_t)(density / 1024U), stress.page_size, jesd216_bfp_addrbytes(bfp));

	zassert_equal(density, stress.dev_size,
		      "SFDP density %u differs from the device size %u",
		      (uint32_t)density, stress.dev_size);

	for (uint8_t i = 1; i <= JESD216_NUM_ERASE_TYPES; i++) {
		if (jesd216_bfp_erase(bfp, i, &et) == 0) {
			printk("  erase type %u: %u KiB, opcode 0x%02x\n", i,
			       (uint32_t)(BIT(et.exp) / 1024U), et.cmd);
		}
	}

	if (jesd216_bfp_decode_dw15(php, bfp, &dw15) == 0) {
		printk("  QER %u (%s)\n", dw15.qer, qer_names[dw15.qer & 7U]);
		if ((stress.read_lanes == 4U || stress.write_lanes == 4U) && dw15.qer == 0U) {
			printk("  WARNING: quad io mode but QER is 0: the driver will not set QE;\n"
			       "           fine only if the part has no QE bit or it is factory set\n");
			warnings++;
		}
	} else {
		printk("  no DW15 in BFP (JESD216 rev < B)\n");
		if (stress.read_lanes == 4U || stress.write_lanes == 4U) {
			printk("  WARNING: quad io mode without DW15: QER unknown to the driver\n");
			warnings++;
		}
	}

	if (jesd216_bfp_decode_dw16(php, bfp, &dw16) == 0) {
		printk("  4-byte address entry methods 0x%02x, soft reset 0x%02x\n",
		       dw16.enter_4ba, dw16.srrs_support);
	}

	printk("  %d warning(s)\n", warnings);
}

ZTEST(s1_identity, test_1_4_size_and_layout)
{
	const struct flash_parameters *fp = flash_get_parameters(stress.dev);
	struct flash_pages_info info;
	size_t count = flash_get_page_count(stress.dev);
	int rc;

	zassert_equal(stress.dev_size, DT_PROP(STRESS_NODE, size) / 8U,
		      "flash_get_size() %u differs from devicetree size %u", stress.dev_size,
		      (uint32_t)(DT_PROP(STRESS_NODE, size) / 8U));

	rc = flash_get_page_info_by_idx(stress.dev, 0, &info);
	zassert_ok(rc, "flash_get_page_info_by_idx() failed: %d", rc);

	printk("  layout: %u pages of %u bytes, erase value 0x%02x, write block %u\n",
	       (uint32_t)count, (uint32_t)info.size, fp->erase_value,
	       (uint32_t)fp->write_block_size);

	zassert_equal((uint64_t)count * info.size, stress.dev_size,
		      "page layout covers %u bytes, device has %u",
		      (uint32_t)(count * info.size), stress.dev_size);
}

ZTEST_SUITE(s1_identity, stress_normal_boot, NULL, stress_before, NULL, NULL);
```

## src/s2_lanes.c
```c
/*
 * Copyright (c) 2026 Filip Stojanovic <filipembedded@gmail.com>
 *
 * SPDX-License-Identifier: Apache-2.0
 *
 * S2: data integrity per IO lane. Every pattern gets its own freshly erased
 * 4 KiB sector, is written once and read back. Mismatches are collected into
 * a per-bit, per-lane and per-position map instead of stopping at the first
 * bad byte.
 */

#include <string.h>
#include <zephyr/sys/printk.h>
#include <zephyr/sys/util.h>

#include "stress.h"

enum pat_kind {
	PAT_CONST,
	PAT_ALT,      /* two alternating bytes */
	PAT_LANE_ON,  /* only the bits of one lane set */
	PAT_LANE_OFF, /* all bits set except one lane */
	PAT_INC,
	PAT_DEC,
	PAT_PRBS,
};

struct pattern {
	char name[16];
	enum pat_kind kind;
	uint8_t a;
	uint8_t b;
};

#define MAX_PATTERNS 32

static struct pattern patterns[MAX_PATTERNS];
static int pattern_count;
static struct stress_err s2_total;
static uint32_t next_sector;

static uint8_t lane_mask(uint8_t lane, uint8_t lanes)
{
	uint8_t m = 0;

	for (int b = lane; b < 8; b += lanes) {
		m |= BIT(b);
	}

	return m;
}

static void add(const char *name, enum pat_kind kind, uint8_t a, uint8_t b)
{
	struct pattern *p = &patterns[pattern_count++];

	strncpy(p->name, name, sizeof(p->name) - 1U);
	p->kind = kind;
	p->a = a;
	p->b = b;
}

static void build_patterns(void)
{
	const uint8_t lanes = MAX(stress.read_lanes, stress.write_lanes);
	char name[16];

	if (pattern_count != 0) {
		return;
	}

	add("0x00", PAT_CONST, 0x00, 0);
	add("0xff", PAT_CONST, 0xff, 0);
	add("0x55", PAT_CONST, 0x55, 0);
	add("0xaa", PAT_CONST, 0xaa, 0);
	add("0x0f", PAT_CONST, 0x0f, 0);
	add("0xf0", PAT_CONST, 0xf0, 0);
	add("0x33", PAT_CONST, 0x33, 0);
	add("0xcc", PAT_CONST, 0xcc, 0);
	add("0x5a/0xa5", PAT_ALT, 0x5a, 0xa5);
	add("0x00/0xff", PAT_ALT, 0x00, 0xff);

	if (lanes > 1U) {
		for (uint8_t l = 0; l < lanes; l++) {
			snprintk(name, sizeof(name), "only IO%u", l);
			add(name, PAT_LANE_ON, lane_mask(l, lanes), 0);
			snprintk(name, sizeof(name), "all but IO%u", l);
			add(name, PAT_LANE_OFF, (uint8_t)~lane_mask(l, lanes), 0);
		}
	} else {
		for (uint8_t b = 0; b < 8; b++) {
			snprintk(name, sizeof(name), "walk1 bit%u", b);
			add(name, PAT_CONST, BIT(b), 0);
		}
	}

	add("increment", PAT_INC, 0, 0);
	add("decrement", PAT_DEC, 0, 0);
	add("prbs", PAT_PRBS, 0, 0);
}

static void generate(const struct pattern *p, uint8_t *buf, size_t len, uint32_t tag)
{
	switch (p->kind) {
	case PAT_CONST:
	case PAT_LANE_ON:
	case PAT_LANE_OFF:
		memset(buf, p->a, len);
		break;
	case PAT_ALT:
		for (size_t i = 0; i < len; i++) {
			buf[i] = (i & 1U) ? p->b : p->a;
		}
		break;
	case PAT_INC:
		for (size_t i = 0; i < len; i++) {
			buf[i] = (uint8_t)i;
		}
		break;
	case PAT_DEC:
		for (size_t i = 0; i < len; i++) {
			buf[i] = (uint8_t)(0xffU - i);
		}
		break;
	case PAT_PRBS:
		stress_fill_prbs(buf, len, stress_seed(tag));
		break;
	}
}

static uint32_t take_sector(void)
{
	uint32_t off = stress_blk(BLK_LANES) + next_sector * STRESS_SECTOR;

	zassert_true(next_sector < 4U * STRESS_BLOCK / STRESS_SECTOR,
		     "S2 ran out of sectors in its 4 blocks");
	next_sector++;

	return off;
}

/*
 * Erase one sector, check it is erased, write the pattern at start with len
 * bytes in a single flash_write() call, then verify.
 */
static void run_one(const struct pattern *p, uint32_t start_in_sector, size_t len,
		    const char *where, uint32_t tag)
{
	struct stress_err e = {0};
	uint32_t sector = take_sector();
	uint32_t off = sector + start_in_sector;
	int rc;

	rc = stress_erase(sector, STRESS_SECTOR);
	zassert_ok(rc, "erase 0x%08x failed: %d", sector, rc);

	if (!stress_verify_erased(sector, STRESS_SECTOR, &e)) {
		printk("  erase of 0x%08x left non-erased bytes\n", sector);
	}

	generate(p, stress_exp, len, tag);
	rc = stress_write(off, stress_exp, len);
	if (rc != 0) {
		printk("  write '%s' at 0x%08x failed: %d\n", p->name, off, rc);
		e.ops_failed++;
	} else {
		(void)stress_verify(off, stress_exp, len, off, &e);
	}

	if (e.bad_bytes != 0U || e.ops_failed != 0U) {
		printk("  FAIL '%s' %s at 0x%08x: %u bad bytes, first 0x%08x exp 0x%02x "
		       "got 0x%02x\n", p->name, where, off, e.bad_bytes, e.first_off,
		       e.first_exp, e.first_got);
	}

	stress_err_merge(&s2_total, &e);
}

ZTEST(s2_lanes, test_2_1_patterns_page_aligned)
{
	struct stress_err before = s2_total;

	build_patterns();
	printk("  %d patterns, %u data lanes\n", pattern_count,
	       MAX(stress.read_lanes, stress.write_lanes));

	for (int i = 0; i < pattern_count; i++) {
		run_one(&patterns[i], 0, STRESS_SECTOR, "aligned", 0x2100U + i);
	}

	zassert_equal(s2_total.bad_bytes, before.bad_bytes, "bad bytes, see the S2 report");
	zassert_equal(s2_total.ops_failed, before.ops_failed, "failed operations");
}

ZTEST(s2_lanes, test_2_2_patterns_unaligned)
{
	struct stress_err before = s2_total;

	build_patterns();

	/* Start mid-page so the first program command is short and later ones span pages. */
	for (int i = 0; i < pattern_count; i++) {
		run_one(&patterns[i], 0x83, STRESS_SECTOR - 0x100, "unaligned", 0x2200U + i);
	}

	zassert_equal(s2_total.bad_bytes, before.bad_bytes, "bad bytes, see the S2 report");
	zassert_equal(s2_total.ops_failed, before.ops_failed, "failed operations");
}

/*
 * Write in chunks of varying size, so program commands start at many
 * different offsets. This is how flash_copy() and file systems write.
 */
ZTEST(s2_lanes, test_2_3_chunked_writes)
{
	static const char *const names[] = {"increment", "prbs"};
	struct stress_err before = s2_total;

	build_patterns();

	for (int n = 0; n < ARRAY_SIZE(names); n++) {
		const struct pattern *p = NULL;
		struct stress_err e = {0};
		uint32_t sector = take_sector();
		uint32_t rnd = stress_seed(0x2300U + n);
		uint32_t done = 0;
		int rc;

		for (int i = 0; i < pattern_count; i++) {
			if (strcmp(patterns[i].name, names[n]) == 0) {
				p = &patterns[i];
			}
		}
		zassert_not_null(p);

		rc = stress_erase(sector, STRESS_SECTOR);
		zassert_ok(rc, "erase failed: %d", rc);

		generate(p, stress_exp, STRESS_SECTOR, 0x2300U + n);

		while (done < STRESS_SECTOR) {
			uint32_t chunk;

			rnd ^= rnd << 13;
			rnd ^= rnd >> 17;
			rnd ^= rnd << 5;
			chunk = MIN(1U + (rnd % 64U), STRESS_SECTOR - done);

			rc = stress_write(sector + done, stress_exp + done, chunk);
			if (rc != 0) {
				e.ops_failed++;
				break;
			}
			/* Verify each chunk against its own program command start. */
			(void)stress_verify(sector + done, stress_exp + done, chunk, sector + done,
					    &e);
			done += chunk;
		}

		/* Final full read: later chunks must not have disturbed earlier ones. */
		(void)stress_verify(sector, stress_exp, STRESS_SECTOR, sector, &e);

		if (e.bad_bytes != 0U || e.ops_failed != 0U) {
			printk("  FAIL chunked '%s': %u bad bytes\n", p->name, e.bad_bytes);
		}
		stress_err_merge(&s2_total, &e);
	}

	zassert_equal(s2_total.bad_bytes, before.bad_bytes, "bad bytes, see the S2 report");
	zassert_equal(s2_total.ops_failed, before.ops_failed, "failed operations");
}

ZTEST(s2_lanes, test_2_9_report)
{
	stress_report("S2 lanes, all patterns", &s2_total);
}

ZTEST_SUITE(s2_lanes, stress_normal_boot, NULL, stress_before, NULL, NULL);
```

## src/s3_geometry.c
```c
/*
 * Copyright (c) 2026 Filip Stojanovic <filipembedded@gmail.com>
 *
 * SPDX-License-Identifier: Apache-2.0
 *
 * S3: geometry and sizes. Write and read lengths, buffer alignment, page and
 * erase boundaries, the 16 MiB (3/4-byte address) boundary and the end of the
 * device.
 */

#include <string.h>
#include <zephyr/sys/printk.h>
#include <zephyr/sys/util.h>

#include "stress.h"

#define WL_MAX     300U
#define CANARY     0xa5U
#define READ_FILL  STRESS_BLOCK

/*
 * Writes of 1..300 bytes, back to back with a one byte gap, starting at an
 * odd offset. Data must match and every gap byte must still be erased.
 */
ZTEST(s3_geometry, test_3_1_write_lengths)
{
	const uint32_t base = stress_blk(BLK_WRITE_LEN);
	struct stress_err e = {0};
	struct stress_err gaps = {0};
	uint32_t p = base + 3U;
	int rc;

	rc = stress_erase(base, 2U * STRESS_BLOCK);
	zassert_ok(rc, "erase failed: %d", rc);

	for (uint32_t len = 1; len <= WL_MAX; len++) {
		stress_fill_prbs(stress_exp, len, stress_seed(0x3100U + len));
		rc = stress_write(p, stress_exp, len);
		if (rc != 0) {
			printk("  write len %u at 0x%08x failed: %d\n", len, p, rc);
			e.ops_failed++;
		}
		p += len + 1U;
	}

	p = base + 3U;
	for (uint32_t len = 1; len <= WL_MAX; len++) {
		stress_fill_prbs(stress_exp, len, stress_seed(0x3100U + len));
		if (!stress_verify(p, stress_exp, len, p, &e) && e.bad_bytes < 64U) {
			printk("  write len %u at 0x%08x reads back wrong\n", len, p);
		}
		(void)stress_verify_erased(p + len, 1, &gaps);
		p += len + 1U;
	}

	stress_report("S3 write lengths 1..300", &e);
	stress_report("S3 gap bytes between writes", &gaps);
	zassert_equal(e.bad_bytes + e.ops_failed, 0, "write length errors");
	zassert_equal(gaps.bad_bytes, 0, "a write touched bytes outside its range");
}

static void fill_read_block(uint32_t base, uint32_t tag)
{
	int rc = stress_erase(base, READ_FILL);

	zassert_ok(rc, "erase failed: %d", rc);

	for (uint32_t o = 0; o < READ_FILL; o += STRESS_SECTOR) {
		stress_fill_prbs(stress_exp, STRESS_SECTOR, stress_seed(tag + o / STRESS_SECTOR));
		rc = stress_write(base + o, stress_exp, STRESS_SECTOR);
		zassert_ok(rc, "fill write failed: %d", rc);
	}
}

/* Expected content of the read block at [o, o + len). */
static void expected_read_block(uint8_t *dst, uint32_t o, size_t len, uint32_t tag)
{
	while (len > 0U) {
		uint32_t s = o / STRESS_SECTOR;
		uint32_t in = o % STRESS_SECTOR;
		size_t n = MIN(len, STRESS_SECTOR - in);

		stress_fill_prbs(stress_got, STRESS_SECTOR, stress_seed(tag + s));
		memcpy(dst, stress_got + in, n);
		dst += n;
		o += n;
		len -= n;
	}
}

static bool read_and_check(uint32_t base, uint32_t o, size_t len, size_t buf_o,
			   struct stress_err *e, uint32_t *guard_errors)
{
	uint8_t *buf = stress_big + STRESS_ALIGN;
	int rc;

	memset(buf - STRESS_ALIGN, CANARY, len + 2U * STRESS_ALIGN);
	rc = stress_read(base + o, buf + buf_o, len);
	if (rc != 0) {
		e->ops_failed++;
		return false;
	}

	if (buf[buf_o - 1] != CANARY || buf[buf_o + len] != CANARY) {
		(*guard_errors)++;
		printk("  read len %u ad_o %u buf_o %u wrote outside the buffer\n",
		       (uint32_t)len, o, (uint32_t)buf_o);
	}

	for (size_t done = 0; done < len; done += STRESS_SECTOR) {
		size_t n = MIN(STRESS_SECTOR, len - done);

		expected_read_block(stress_exp, o + done, n, 0x3200U);
		stress_compare(stress_exp, buf + buf_o + done, n, base + o + done, base + o, e);
	}
	return true;
}

/*
 * Reads of many lengths, at unaligned flash offsets and into unaligned
 * buffers, with guard bytes around the buffer. Covers FIFO and DMA edges,
 * cache line splits and packet_data_limit.
 */
ZTEST(s3_geometry, test_3_2_read_lengths)
{
	static const uint32_t special[] = {
		31, 32, 33, 63, 64, 65, 127, 128, 129, 255, 256, 257,
		511, 512, 513, 1023, 1024, 1025, 4095, 4096, 4097,
	};
	const uint32_t base = stress_blk(BLK_READ_LEN);
	struct stress_err e = {0};
	uint32_t guard_errors = 0;

	fill_read_block(base, 0x3200U);

	for (size_t len = 0; len <= 64U; len++) {
		for (uint32_t ad_o = 0; ad_o < 8U; ad_o++) {
			for (size_t buf_o = 1; buf_o <= 8U; buf_o++) {
				(void)read_and_check(base, ad_o, len, buf_o, &e, &guard_errors);
			}
		}
	}

	for (size_t i = 0; i < ARRAY_SIZE(special); i++) {
		for (uint32_t ad_o = 0; ad_o < 2U; ad_o++) {
			(void)read_and_check(base, 0x100U + ad_o, special[i], 1U + ad_o, &e,
					     &guard_errors);
		}
	}

	/* One large read, aligned and unaligned. */
	for (uint32_t ad_o = 0; ad_o < 2U; ad_o++) {
		size_t len = MIN(CONFIG_MSPI_STRESS_BIG_READ_SIZE, READ_FILL - ad_o);
		uint8_t *buf = stress_big + STRESS_ALIGN;
		int rc;

		rc = stress_read(base + ad_o, buf + ad_o, len);
		if (rc != 0) {
			e.ops_failed++;
			continue;
		}
		for (size_t o = 0; o < len; o += STRESS_SECTOR) {
			size_t n = MIN(STRESS_SECTOR, len - o);

			expected_read_block(stress_exp, ad_o + o, n, 0x3200U);
			stress_compare(stress_exp, buf + ad_o + o, n, base + ad_o + o,
				       base + ad_o + o, &e);
		}
	}

	stress_report("S3 read lengths and alignment", &e);
	printk("  guard violations: %u\n", guard_errors);
	zassert_equal(e.bad_bytes + e.ops_failed, 0, "read errors");
	zassert_equal(guard_errors, 0, "reads wrote outside the destination buffer");
}

/*
 * Program three neighbouring blocks, erase part of the middle one with each
 * erase size, and check that exactly that range was erased.
 */
ZTEST(s3_geometry, test_3_3_erase_guard)
{
	static const struct {
		uint32_t size;
		uint32_t at; /* offset inside the middle block */
	} cases[] = {
		{STRESS_SECTOR, 0x5000},
		{0x8000, 0x8000},
		{STRESS_BLOCK, 0},
	};
	const uint32_t base = stress_blk(BLK_ERASE_GUARD);
	struct stress_err e = {0};
	int rc;

	for (size_t c = 0; c < ARRAY_SIZE(cases); c++) {
		const uint32_t er_start = base + STRESS_BLOCK + cases[c].at;
		const uint32_t er_end = er_start + cases[c].size;

		rc = stress_erase(base, 3U * STRESS_BLOCK);
		zassert_ok(rc, "erase failed: %d", rc);

		for (uint32_t o = 0; o < 3U * STRESS_BLOCK; o += STRESS_SECTOR) {
			stress_fill_prbs(stress_exp, STRESS_SECTOR,
					 stress_seed(0x3300U + c * 64U + o / STRESS_SECTOR));
			rc = stress_write(base + o, stress_exp, STRESS_SECTOR);
			zassert_ok(rc, "fill write failed: %d", rc);
		}

		rc = stress_erase(er_start, cases[c].size);
		if (rc != 0) {
			printk("  erase of %u KiB at 0x%08x returned %d, size not supported\n",
			       cases[c].size / 1024U, er_start, rc);
			zassert_true(cases[c].size != STRESS_SECTOR, "4 KiB erase must work");
			continue;
		}

		struct stress_err ce = {0};

		for (uint32_t o = 0; o < 3U * STRESS_BLOCK; o += STRESS_SECTOR) {
			uint32_t s = base + o;

			if (s >= er_start && s < er_end) {
				(void)stress_verify_erased(s, STRESS_SECTOR, &ce);
			} else {
				stress_fill_prbs(stress_exp, STRESS_SECTOR,
						 stress_seed(0x3300U + c * 64U + o / STRESS_SECTOR));
				(void)stress_verify(s, stress_exp, STRESS_SECTOR, s, &ce);
			}
		}

		if (ce.bad_bytes != 0U) {
			printk("  erase %u KiB at 0x%08x: %u bad bytes, first at 0x%08x "
			       "(exp 0x%02x got 0x%02x) %s\n", cases[c].size / 1024U, er_start,
			       ce.bad_bytes, ce.first_off, ce.first_exp, ce.first_got,
			       (ce.first_off >= er_start && ce.first_off < er_end)
				       ? "inside the range (not erased)"
				       : "outside the range (neighbour erased)");
		} else {
			printk("  erase %u KiB at 0x%08x: exact\n", cases[c].size / 1024U,
			       er_start);
		}
		stress_err_merge(&e, &ce);
	}

	zassert_equal(e.bad_bytes + e.ops_failed, 0, "erase did not hit exactly its range");
}

/* Read-only: the far ends of the address space must be readable. */
ZTEST(s3_geometry, test_3_4_far_reads)
{
	uint32_t offs[3] = {0, stress.dev_size - STRESS_SECTOR, 0};
	int n = 2;
	int rc;

	if (stress.dev_size > 0x1000000U) {
		offs[n++] = 0x1000000U - 0x80U;
	}

	for (int i = 0; i < n; i++) {
		rc = stress_read(offs[i], stress_got, STRESS_SECTOR);
		zassert_ok(rc, "read at 0x%08x failed: %d", offs[i], rc);
	}

	printk("  reads at 0x0, end of device%s OK\n",
	       (n == 3) ? " and across 16 MiB" : "");
}

/*
 * Opt-in, erases outside the test region: write across the 16 MiB boundary
 * and in the last sector, and check offset 0 did not change (address wrap).
 */
ZTEST(s3_geometry, test_3_5_boundaries_outside_region)
{
#if defined(CONFIG_MSPI_STRESS_OUTSIDE_REGION)
	struct stress_err e = {0};
	uint32_t targets[2] = {stress.dev_size - STRESS_SECTOR, 0};
	int n = 1;
	int rc;

	rc = stress_read(0, stress_big, STRESS_SECTOR);
	zassert_ok(rc);

	if (stress.dev_size > 0x1000000U) {
		targets[n++] = 0x1000000U - STRESS_SECTOR;
	}

	for (int i = 0; i < n; i++) {
		uint32_t t = targets[i];
		uint32_t len = (i == 0) ? STRESS_SECTOR : 2U * STRESS_SECTOR;
		uint32_t w = (i == 0) ? t : 0x1000000U - 0x80U;
		uint32_t wl = (i == 0) ? STRESS_SECTOR : 0x100U;

		rc = stress_erase(t, len);
		zassert_ok(rc, "erase 0x%08x failed: %d", t, rc);
		stress_fill_prbs(stress_exp, wl, stress_seed(0x3500U + i));
		rc = stress_write(w, stress_exp, wl);
		zassert_ok(rc, "write 0x%08x failed: %d", w, rc);
		(void)stress_verify(w, stress_exp, wl, w, &e);
	}

	rc = stress_read(0, stress_got, STRESS_SECTOR);
	zassert_ok(rc);
	zassert_mem_equal(stress_big, stress_got, STRESS_SECTOR,
			  "offset 0 changed: high addresses wrap around (address width or "
			  "flash size setting)");

	stress_report("S3 16 MiB boundary and last sector", &e);
	zassert_equal(e.bad_bytes, 0, "boundary errors");
#else
	printk("  enable CONFIG_MSPI_STRESS_OUTSIDE_REGION to run (erases outside the region)\n");
	ztest_test_skip();
#endif
}

ZTEST_SUITE(s3_geometry, stress_normal_boot, NULL, stress_before, NULL, NULL);
```

## src/s4_sequence.c
```c
/*
 * Copyright (c) 2026 Filip Stojanovic <filipembedded@gmail.com>
 *
 * SPDX-License-Identifier: Apache-2.0
 *
 * S4: command sequences. Many short commands back to back: write then read
 * right away, erase then read, tiny reads, and reads mixed with ID and SFDP
 * commands. Stresses chip select high time, busy polling and mode changes.
 */

#include <string.h>
#include <zephyr/sys/byteorder.h>
#include <zephyr/sys/printk.h>
#include <zephyr/sys/util.h>

#include <jesd216.h>

#include "stress.h"

#define PAIRS      512U
#define PAIR_LEN   16U
#define TINY_READS 2000U

BUILD_ASSERT(CONFIG_MSPI_STRESS_BIG_READ_SIZE >= PAIRS * PAIR_LEN,
	     "MSPI_STRESS_BIG_READ_SIZE must hold the S4 expected image");

ZTEST(s4_sequence, test_4_1_write_read_pairs)
{
	const uint32_t base = stress_blk(BLK_SEQUENCE);
	struct stress_err e = {0};
	int rc;

	rc = stress_erase(base, PAIRS * PAIR_LEN);
	zassert_ok(rc, "erase failed: %d", rc);

	/* Keep the whole expected image for test_4_3. */
	stress_fill_prbs(stress_big, PAIRS * PAIR_LEN, stress_seed(0x4100U));

	for (uint32_t i = 0; i < PAIRS; i++) {
		uint32_t off = base + i * PAIR_LEN;

		rc = stress_write(off, stress_big + i * PAIR_LEN, PAIR_LEN);
		if (rc != 0) {
			e.ops_failed++;
			continue;
		}
		(void)stress_verify(off, stress_big + i * PAIR_LEN, PAIR_LEN, off, &e);
	}

	stress_report("S4 write+read pairs", &e);
	zassert_equal(e.bad_bytes + e.ops_failed, 0, "write/read pair errors");
}

ZTEST(s4_sequence, test_4_2_erase_then_read)
{
	const uint32_t base = stress_blk(BLK_SEQUENCE) + 0x8000U;
	struct stress_err e = {0};
	int rc;

	for (uint32_t k = 0; k < 8U; k++) {
		uint32_t s = base + k * STRESS_SECTOR;
		uint8_t v = (uint8_t)(0x11U * (k + 1U));

		rc = stress_erase(s, STRESS_SECTOR);
		if (rc != 0) {
			e.ops_failed++;
			continue;
		}
		/* Read immediately: a premature busy release shows up here. */
		(void)stress_verify_erased(s, STRESS_SECTOR, &e);

		rc = stress_write(s + k, &v, 1);
		if (rc != 0) {
			e.ops_failed++;
			continue;
		}
		(void)stress_verify(s + k, &v, 1, s + k, &e);
	}

	stress_report("S4 erase then read", &e);
	zassert_equal(e.bad_bytes + e.ops_failed, 0, "erase/read sequence errors");
}

ZTEST(s4_sequence, test_4_3_tiny_reads)
{
	const uint32_t base = stress_blk(BLK_SEQUENCE);
	struct stress_err e = {0};
	uint32_t rnd = stress_seed(0x4300U);

	/* test_4_1 left PAIRS * PAIR_LEN bytes of prbs at base. */
	stress_fill_prbs(stress_big, PAIRS * PAIR_LEN, stress_seed(0x4100U));

	for (uint32_t i = 0; i < TINY_READS; i++) {
		uint32_t o;
		uint32_t len;

		rnd ^= rnd << 13;
		rnd ^= rnd >> 17;
		rnd ^= rnd << 5;
		len = 1U + (rnd % 3U);
		o = (rnd >> 8) % (PAIRS * PAIR_LEN - len);

		if (stress_read(base + o, stress_got, len) != 0) {
			e.ops_failed++;
			continue;
		}
		stress_compare(stress_big + o, stress_got, len, base + o, base + o, &e);
	}

	stress_report("S4 tiny random reads", &e);
	zassert_equal(e.bad_bytes + e.ops_failed, 0, "tiny read errors");
}

ZTEST(s4_sequence, test_4_4_mixed_commands)
{
#if defined(CONFIG_FLASH_JESD216_API)
	const uint32_t base = stress_blk(BLK_SEQUENCE);
	struct stress_err e = {0};
	uint8_t id0[8] = {0};
	uint8_t id[8];
	uint32_t magic;
	uint32_t id_errors = 0;
	uint32_t sfdp_errors = 0;
	bool have_id;

	bool have_sfdp;

	have_id = (flash_read_jedec_id(stress.dev, id0) == 0);
	have_sfdp = (flash_sfdp_read(stress.dev, 0, &magic, sizeof(magic)) == 0) &&
		    (sys_le32_to_cpu(magic) == JESD216_SFDP_MAGIC);
	if (!have_sfdp) {
		printk("  SFDP not readable in this mode (see S1), mixing in JEDEC ID only\n");
	}
	stress_fill_prbs(stress_big, PAIRS * PAIR_LEN, stress_seed(0x4100U));

	for (uint32_t i = 0; i < 200U; i++) {
		uint32_t o = (i * 37U) % (PAIRS * PAIR_LEN - 64U);

		if (have_id) {
			if (flash_read_jedec_id(stress.dev, id) != 0 || memcmp(id, id0, 3) != 0) {
				id_errors++;
			}
		}
		if (have_sfdp &&
		    (flash_sfdp_read(stress.dev, 0, &magic, sizeof(magic)) != 0 ||
		     sys_le32_to_cpu(magic) != JESD216_SFDP_MAGIC)) {
			sfdp_errors++;
		}
		if (stress_read(base + o, stress_got, 64) != 0) {
			e.ops_failed++;
			continue;
		}
		stress_compare(stress_big + o, stress_got, 64, base + o, base + o, &e);
	}

	stress_report("S4 data reads mixed with ID/SFDP", &e);
	printk("  JEDEC ID errors: %u, SFDP signature errors: %u\n", id_errors, sfdp_errors);
	zassert_equal(e.bad_bytes + e.ops_failed, 0, "data errors between ID/SFDP reads");
	zassert_equal(id_errors + sfdp_errors, 0, "ID/SFDP errors between data reads");
#else
	ztest_test_skip();
#endif
}

ZTEST_SUITE(s4_sequence, stress_normal_boot, NULL, stress_before, NULL, NULL);
```

## src/s6_coherency.c
```c
/*
 * Copyright (c) 2026 Filip Stojanovic <filipembedded@gmail.com>
 *
 * SPDX-License-Identifier: Apache-2.0
 *
 * S6: read-after-write coherency. Read an area first (so caches, DMA buffers
 * and any memory-mapped window hold it), then change it and read again. Stale
 * data shows up as erased bytes where new data was written.
 */

#include <string.h>
#include <zephyr/sys/printk.h>
#include <zephyr/sys/util.h>

#include "stress.h"

ZTEST(s6_coherency, test_6_1_read_write_read)
{
	static const struct {
		uint32_t at;
		uint32_t len;
	} cases[] = {
		/* Disjoint ranges: NOR programming can only clear bits. */
		{31, 1}, {32, 31}, {63, 33}, {100, 64}, {192, 32}, {1000, 512}, {3990, 96},
	};
	const uint32_t base = stress_blk(BLK_COHERENCY);
	struct stress_err e = {0};
	int rc;

	for (uint32_t sec = 0; sec < 2U; sec++) {
		uint32_t s = base + sec * STRESS_SECTOR;

		rc = stress_erase(s, STRESS_SECTOR);
		zassert_ok(rc, "erase failed: %d", rc);

		/* Model of what the sector should contain. */
		memset(stress_exp, stress.erase_value, STRESS_SECTOR);

		for (size_t c = 0; c < ARRAY_SIZE(cases); c++) {
			uint8_t data[512];
			uint32_t at = cases[c].at + sec;
			uint32_t len = MIN(cases[c].len, STRESS_SECTOR - at);

			/* 1: read the whole sector, priming every cache on the way. */
			(void)stress_verify(s, stress_exp, STRESS_SECTOR, s, &e);

			/* 2: change part of it. */
			stress_fill_prbs(data, len, stress_seed(0x6100U + sec * 16U + c));
			rc = stress_write(s + at, data, len);
			if (rc != 0) {
				e.ops_failed++;
				continue;
			}
			memcpy(stress_exp + at, data, len);

			/* 3: the next read must see the new bytes, not the cached erased ones. */
			(void)stress_verify(s, stress_exp, STRESS_SECTOR, s + at, &e);
		}
	}

	stress_report("S6 read-write-read", &e);
	zassert_equal(e.bad_bytes + e.ops_failed, 0, "stale or wrong data after a write");
}

/* Same destination buffer, different flash data each time. */
ZTEST(s6_coherency, test_6_2_buffer_reuse)
{
	const uint32_t base = stress_blk(BLK_COHERENCY) + 2U * STRESS_SECTOR;
	struct stress_err e = {0};
	int rc;

	rc = stress_erase(base, 2U * STRESS_SECTOR);
	zassert_ok(rc, "erase failed: %d", rc);

	for (uint32_t k = 0; k < 2U; k++) {
		stress_fill_prbs(stress_exp, STRESS_SECTOR, stress_seed(0x6200U + k));
		rc = stress_write(base + k * STRESS_SECTOR, stress_exp, STRESS_SECTOR);
		zassert_ok(rc, "write failed: %d", rc);
	}

	for (uint32_t i = 0; i < 16U; i++) {
		uint32_t k = i & 1U;

		rc = stress_read(base + k * STRESS_SECTOR, stress_got, STRESS_SECTOR);
		if (rc != 0) {
			e.ops_failed++;
			continue;
		}
		stress_fill_prbs(stress_exp, STRESS_SECTOR, stress_seed(0x6200U + k));
		stress_compare(stress_exp, stress_got, STRESS_SECTOR, base + k * STRESS_SECTOR,
			       base + k * STRESS_SECTOR, &e);
	}

	stress_report("S6 buffer reuse", &e);
	zassert_equal(e.bad_bytes + e.ops_failed, 0, "stale data in a reused buffer");
}

ZTEST_SUITE(s6_coherency, stress_normal_boot, NULL, stress_before, NULL, NULL);
```

## src/s9_report.c
```c
/*
 * Copyright (c) 2026 Filip Stojanovic <filipembedded@gmail.com>
 *
 * SPDX-License-Identifier: Apache-2.0
 *
 * S9: wear and traffic summary. Runs last (suites run in name order).
 */

#include <zephyr/sys/printk.h>

#include "stress.h"

ZTEST(s9_report, test_9_1_wear_budget)
{
	uint32_t max = 0;
	uint32_t max_idx = 0;
	uint32_t total = 0;

	for (uint32_t i = 0; i < STRESS_SECTORS; i++) {
		total += stress_wear.erases[i];
		if (stress_wear.erases[i] > max) {
			max = stress_wear.erases[i];
			max_idx = i;
		}
	}

	printk("\n=== mspi_stress summary ===\n");
	printk("  erase calls        : %u\n", stress_wear.erase_ops);
	printk("  sector erases      : %u in the region, %u outside\n", total,
	       stress_wear.erase_outside);
	printk("  most erased sector : 0x%08x, %u times (budget %u)\n",
	       stress.region + max_idx * STRESS_SECTOR, max, CONFIG_MSPI_STRESS_ERASE_BUDGET);
	printk("  bytes written      : %u KiB\n", (uint32_t)(stress_wear.bytes_written / 1024U));
	printk("  bytes read         : %u KiB\n", (uint32_t)(stress_wear.bytes_read / 1024U));
	printk("  NOR endurance is typically 100k cycles per sector\n\n");

	zassert_true(max <= CONFIG_MSPI_STRESS_ERASE_BUDGET,
		     "a sector was erased %u times, more than the budget of %u", max,
		     CONFIG_MSPI_STRESS_ERASE_BUDGET);
}

ZTEST_SUITE(s9_report, stress_normal_boot, NULL, stress_before, NULL, NULL);
```
